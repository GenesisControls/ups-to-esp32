## firmware/components/auth/Kconfig.projbuild
```kconfig
# SPDX-License-Identifier: GPL-3.0-or-later

menu "My UPS Pal login"

config UPSA_DEFAULT_ADMIN_USER
    string "Default admin username (empty: no default login)"
    default ""
    help
        Seeded into NVS by auth_init() on a board that has no login stored,
        so the board is usable the moment it powers up and the setup page does
        not have to insist on a login before it will do anything.

        EMPTY IS THE UPSTREAM BEHAVIOUR and the default: no login exists until
        someone chooses one, and the setup form requires it. Leave it empty
        unless a deployment has a reason to ship a known login.

        A default set here is compiled into the image, and under GPL the
        corresponding source goes to whoever receives that image -- so treat
        anything set here as public. A per-device default derived from the MAC
        is stronger if you can label the boards.

config UPSA_DEFAULT_ADMIN_PASS
    string "Default admin password"
    default ""
    help
        Used only when UPSA_DEFAULT_ADMIN_USER is set. 8-64 characters, no
        spaces or quotes (authc_shape_ok). Stored salted and hashed like any
        other password; only this build-time string is plain text.

        While the login is still this default, auth_is_default() is true and
        the web page says so. It is a notice, not a gate: nothing is blocked.

endmenu
```

## firmware/components/fleet/Kconfig.projbuild
```kconfig
menu "My UPS Pal fleet heartbeat"

config UPSA_FLEET_URL
    string "Fleet heartbeat endpoint (Supabase project URL)"
    default ""
    help
        The Supabase project URL, e.g. https://abcd.supabase.co. The board
        calls its heartbeat() function there. Empty: the heartbeat is built
        in but never sends, and the page says it is not configured.

config UPSA_FLEET_KEY
    string "Fleet heartbeat public key"
    default ""
    help
        The project's PUBLIC (anon / publishable) key. It ships in open-source
        firmware, so it must only be able to call heartbeat(): see
        telemetry/supabase.sql. Never the service_role key.

config UPSA_FLEET_DISABLED
    bool "Never start the check-in at all"
    default n
    help
        Stronger than leaving the endpoint empty. With no URL the task still
        runs and finds nothing to do, costing a 6 KB stack for a feature that
        will never be used; with this set, fleet_start() returns before
        creating it.

        For a deployment that has decided it does not want fleet reporting at
        all, rather than one that has not configured it yet. The page reports
        it as not configured either way, and nothing can turn it on without a
        rebuild.

endmenu
```

## firmware/components/netmgr/Kconfig.projbuild
```kconfig
# SPDX-License-Identifier: GPL-3.0-or-later

menu "My UPS Pal setup access point"

config UPSA_AP_WINDOW_S
    int "Seconds the setup AP stays up with nobody on it (0: for ever)"
    default 0
    range 0 86400
    help
        0 is the upstream behaviour and the default: the setup access point
        stays up until the board joins a network. Right when the board is
        useless until it does.

        Set it, and a board that has not joined a network keeps its access
        point for this long and then turns the radio OFF -- not a hidden
        SSID, off. The clock restarts whenever a client is associated, so it
        never closes under someone's feet while they are configuring it, and
        it restarts again on every press of BOOT.

        For this adapter the UPS data goes out over RS485 and the radio exists
        only so a technician can open the page. Leaving an open access point
        broadcasting for years in twenty customer buildings is a standing
        invitation; ten minutes after power-up is enough to configure a board.

        THE WAY BACK IS PHYSICAL, by design: press BOOT, or power-cycle the
        board, and the window starts again. Both are available to anyone who
        can reach the board, and neither needs the network that is off.

        A board that HAS joined a network is never touched by this: its radio
        is carrying data.

endmenu
```

## firmware/components/ota/Kconfig.projbuild
```kconfig
# SPDX-License-Identifier: GPL-3.0-or-later

menu "My UPS Pal updates"

config UPSA_OTA_REPO
    string "GitHub repository to check for releases (owner/name)"
    default "aronreid/ups-to-esp32"
    help
        Where the board looks for firmware. The default is upstream's own
        repository, which is right for upstream's boards and wrong for a
        fork: assets are named ups-adaptor-<BOARD_OTA_TARGET>.bin, so a board
        with its own target finds nothing there and checks for ever in vain.

        A fork shipping its own boards points this at its own repository and
        publishes assets for its own target.

config UPSA_OTA_NO_AUTO_CHECK
    bool "Never check for updates unless the owner turns it on"
    default n
    help
        Upstream defaults the periodic CHECK to ON (ota.c), on the reasoning
        that a device which never looks can never tell its owner an update
        exists. Note that ota.h's comment says the opposite; the code is what
        runs.

        Turn this on for boards installed on other people's networks. A
        device reaching the internet on a timer from inside a customer's
        building is their decision, and the honest default for gear we
        install there is not to, until someone asks for it. The owner can
        still enable checking on the page, and installing always needs a
        person either way.

endmenu
```

## firmware/components/webui/Kconfig.projbuild
```kconfig
# SPDX-License-Identifier: GPL-3.0-or-later

menu "My UPS Pal web page"

config UPSA_SETUP_SCREEN
    bool "Show the guided Wi-Fi setup screen on a board with no network"
    default y
    help
        With this on (the upstream behaviour), a board that has not joined a
        network shows nothing but the Wi-Fi card: the menu, the status and
        every other card are hidden until it joins one. That is right when the
        network IS the product -- the board is useless until it is on one.

        Turn it OFF for a board whose network is optional. This adapter sends
        its UPS data over RS485 and most units never join a Wi-Fi at all; the
        radio exists so a technician can open the page. Leaving the guided
        screen on would leave those boards behind a Wi-Fi form for their whole
        service life, with no way to reach anything else.

        Off, the page comes up normally on the board's own access point and
        Wi-Fi is one ordinary card among the others, there if it is wanted.

endmenu
```
